## conf/layer.conf
```bitbake
# We have a conf and classes directory, add to BBPATH
BBPATH .= ":${LAYERDIR}"

# We have recipes-* directories, add to BBFILES
BBFILES += "${LAYERDIR}/recipes-*/*/*.bb \
            ${LAYERDIR}/recipes-*/*/*.bbappend"

BBFILE_COLLECTIONS += "meta-noccarc"
BBFILE_PATTERN_meta-noccarc = "^${LAYERDIR}/"
BBFILE_PRIORITY_meta-noccarc = "7"

EULA_FILE_ST_stm32mp730isommx = "${LAYERDIR}/conf/eula/${MACHINE}"
EULA_FILE_ST_MD5SUM_stm32mp730isommx = "8b505090fb679839cefbcc784afe8ce9"

#Inform bitbake for adding another location to search for licenses
LICENSE_PATH += "${LAYERDIR}/files/licenses"

# Set a variable to get the STM32MP MX BSP location
STM32MP_noccarc_BASE = "${LAYERDIR}"

# This should only be incremented on significant changes that may
# cause compatibility issues with other layers
LAYERVERSION_meta-noccarc = "1"
LAYERDEPENDS_meta-noccarc = "stm-st-stm32mp-mx"
LAYERSERIES_COMPAT_meta-noccarc = "dunfell"

DISTRO_FEATURES_remove = " x11 "
DISTRO_FEATURES_append = " systemd"
PARALLEL_MAKE_pn-qtwebkit = "-j 8"
hostname_pn-base-files = "V730i_system_som"
```
